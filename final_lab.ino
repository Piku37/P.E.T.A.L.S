#include "config.h"
#include <DHT.h>  // Include DHT sensor library
#include <Wire.h>
#include <Adafruit_GFX.h>
#include <Adafruit_SSD1306.h>

/************************** Configuration ***********************************/
#define DHTPIN 2   // Define the pin connected to the DHT sensor
#define DHTTYPE DHT11  // Define the type of DHT sensor

DHT dht(DHTPIN, DHTTYPE); // Initialize DHT sensor

/************************ Adafruit display *******************************/
#define SCREEN_WIDTH 128 // OLED display width, in pixels
#define SCREEN_HEIGHT 64 // OLED display height, in pixels

// Declaration for an SSD1306 display connected to I2C (SDA, SCL pins)
#define OLED_RESET -1
Adafruit_SSD1306 display(SCREEN_WIDTH, SCREEN_HEIGHT, &Wire, OLED_RESET);

// Define the Adafruit IO feed
AdafruitIO_Feed *zap1 = io.feed("zap1");
AdafruitIO_Feed *zap2 = io.feed("zap2");

const int soilMoisturePin = 34; // Define the pin connected to the soil moisture sensor

// Define thresholds for sensor readings
const float minTemperature = 18.0; // Minimum temperature for plant happiness
const float maxTemperature = 30.0; // Maximum temperature for plant happiness
const float minHumidity = 40.0;    // Minimum humidity for plant happiness
const float maxHumidity = 80.0;    // Maximum humidity for plant happiness
const int minSoilMoisture = 300;   // Minimum soil moisture for plant happiness
const int maxsoilMoisture = 800;
// Function declarations
void handleZap1Message(AdafruitIO_Data *data);
void handleZap2Message(AdafruitIO_Data *data);
void happyDisplay();
void unhappyDisplay(float temperature, float humidity, int soilMoisture);

//bitmapdata
const unsigned char Calendar [] PROGMEM = {
	0xff, 0xff, 0xff, 0xff, 0xff, 0xff, 0xff, 0xff, 0xff, 0xff, 0xff, 0xff, 0xff, 0xff, 0xff, 0xff, 
	0xff, 0xff, 0xff, 0xff, 0xff, 0xff, 0xff, 0xff, 0xff, 0xff, 0xff, 0xff, 0xff, 0xff, 0xff, 0xff, 
	0xff, 0xff, 0x83, 0xff, 0xff, 0xe0, 0xff, 0xff, 0xff, 0xff, 0x01, 0xff, 0xff, 0xc0, 0x7f, 0xff, 
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	0xff, 0xff, 0xff, 0xff, 0xff, 0xff, 0xff, 0xff, 0xff, 0xff, 0xff, 0xff, 0xff, 0xff, 0xff, 0xff
};

const unsigned char Mail [] PROGMEM = {
  0xff, 0xff, 0xff, 0xff, 0xff, 0xff, 0xff, 0xff, 0xff, 0xff, 0xff, 0xff, 0xff, 0xff, 0xff, 0xff, 
	0xff, 0xff, 0xff, 0xff, 0xff, 0xff, 0xff, 0xff, 0xff, 0xff, 0xff, 0xff, 0xff, 0xff, 0xff, 0xff, 
	0xff, 0xff, 0xff, 0xff, 0xff, 0xff, 0xff, 0xff, 0xff, 0xff, 0xff, 0xff, 0xff, 0xff, 0xff, 0xff, 
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	0xff, 0xff, 0xff, 0xff, 0xff, 0xff, 0xff, 0xff, 0xff, 0xff, 0xff, 0xff, 0xff, 0xff, 0xff, 0xff
};

//happy
const unsigned char happy [] PROGMEM = {
	0x00, 0x00, 0x00, 0x00, 0x00, 0x00, 0x00, 0x00, 0x00, 0x00, 0x00, 0x00, 0x00, 0x00, 0x00, 0x00, 
	0x00, 0x00, 0x00, 0x00, 0x00, 0x00, 0x00, 0x00, 0x00, 0x00, 0x00, 0x00, 0x00, 0x00, 0x00, 0x00, 
	0x00, 0x00, 0x00, 0x00, 0x00, 0x00, 0x00, 0x00, 0x00, 0x00, 0x00, 0x00, 0x00, 0x00, 0x00, 0x00, 
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	0x00, 0x00, 0x00, 0x00, 0x00, 0x00, 0x00, 0x00, 0x00, 0x00, 0x00, 0x00, 0x00, 0x00, 0x00, 0x00
};


// 'sad', 64x64px
const unsigned char sad [] PROGMEM = {
	0x00, 0x00, 0x00, 0x00, 0x00, 0x00, 0x00, 0x00, 0x00, 0x00, 0x00, 0x00, 0x00, 0x00, 0x00, 0x00, 
	0x00, 0x00, 0x00, 0x00, 0x00, 0x00, 0x00, 0x00, 0x00, 0x00, 0x00, 0x00, 0x00, 0x00, 0x00, 0x00, 
	0x00, 0x00, 0x00, 0x00, 0x00, 0x00, 0x00, 0x00, 0x00, 0x00, 0x00, 0x00, 0x00, 0x00, 0x00, 0x00, 
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	0x00, 0x00, 0x00, 0x00, 0x00, 0x00, 0x00, 0x00, 0x00, 0x00, 0x00, 0x00, 0x00, 0x00, 0x00, 0x00
};

// 'sun'
const unsigned char sun [] PROGMEM = {
	0xff, 0xff, 0xff, 0xff, 0xff, 0xff, 0xff, 0xff, 0xff, 0xff, 0xff, 0xff, 0xff, 0xff, 0xff, 0xff, 
	0xff, 0xff, 0xff, 0xfe, 0x7f, 0xff, 0xff, 0xff, 0xff, 0xff, 0xff, 0xfe, 0x3f, 0xff, 0xff, 0xff, 
	0xff, 0xff, 0xff, 0xfc, 0x3f, 0xff, 0xff, 0xff, 0xff, 0xff, 0xff, 0xfc, 0x1f, 0xff, 0xff, 0xff, 
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	0xff, 0xff, 0xff, 0xff, 0xff, 0xff, 0xff, 0xff, 0xff, 0xff, 0xff, 0xff, 0xff, 0xff, 0xff, 0xff
};

// 'thermometer', 64x64px
const unsigned char thermometer [] PROGMEM = {
	0xff, 0xff, 0xff, 0xfc, 0x3f, 0xff, 0xff, 0xff, 0xff, 0xff, 0xff, 0xf0, 0x0f, 0xff, 0xff, 0xff, 
	0xff, 0xff, 0xff, 0xe0, 0x07, 0xff, 0xff, 0xff, 0xff, 0xff, 0xff, 0xc0, 0x03, 0xff, 0xff, 0xff, 
	0xff, 0xff, 0xff, 0x83, 0xc1, 0xff, 0xff, 0xff, 0xff, 0xff, 0xff, 0x87, 0xe1, 0xff, 0xff, 0xff, 
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	0xff, 0xff, 0xff, 0xe0, 0x07, 0xff, 0xff, 0xff, 0xff, 0xff, 0xff, 0xf8, 0x1f, 0xff, 0xff, 0xff
};


// 'water', 64x64px
const unsigned char water [] PROGMEM = {
	0xff, 0xff, 0xff, 0xff, 0xff, 0xff, 0xff, 0xff, 0xff, 0xff, 0xff, 0xff, 0xff, 0xff, 0xff, 0xff, 
	0xff, 0xff, 0xff, 0xff, 0xff, 0xff, 0xff, 0xff, 0xff, 0xff, 0xff, 0xff, 0xff, 0xff, 0xff, 0xff, 
	0xff, 0xff, 0xff, 0xff, 0xfc, 0x01, 0xff, 0xff, 0xff, 0xff, 0xff, 0xff, 0xf0, 0x00, 0x7f, 0xff, 
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	0xff, 0xff, 0xff, 0xff, 0xff, 0xff, 0xff, 0xff, 0xff, 0xff, 0xff, 0xff, 0xff, 0xff, 0xff, 0xff
};

// 'wifi', 64x64px
const unsigned char wifi [] PROGMEM = {
	0xff, 0xff, 0xff, 0x00, 0x00, 0xff, 0xff, 0xff, 0xff, 0xff, 0xe0, 0x00, 0x00, 0x0f, 0xff, 0xff, 
	0xff, 0xff, 0x00, 0x00, 0x00, 0x00, 0xff, 0xff, 0xff, 0xfc, 0x00, 0xff, 0xfe, 0x00, 0x3f, 0xff, 
	0xff, 0xf0, 0x0f, 0xff, 0xff, 0xe0, 0x0f, 0xff, 0xff, 0xc0, 0x7f, 0xff, 0xff, 0xfe, 0x03, 0xff, 
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	0xff, 0xff, 0xff, 0xff, 0xff, 0xff, 0xff, 0xff, 0xff, 0xff, 0xff, 0xff, 0xff, 0xff, 0xff, 0xff
};

const unsigned char Calendar [] PROGMEM = {
	0xff, 0xff, 0xff, 0xff, 0xff, 0xff, 0xff, 0xff, 0xff, 0xff, 0xff, 0xff, 0xff, 0xff, 0xff, 0xff, 
	0xff, 0xff, 0xff, 0xff, 0xff, 0xff, 0xff, 0xff, 0xff, 0xff, 0xff, 0xff, 0xff, 0xff, 0xff, 0xff, 
	0xff, 0xff, 0x83, 0xff, 0xff, 0xe0, 0xff, 0xff, 0xff, 0xff, 0x01, 0xff, 0xff, 0xc0, 0x7f, 0xff, 
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	0xff, 0xff, 0xff, 0xff, 0xff, 0xff, 0xff, 0xff, 0xff, 0xff, 0xff, 0xff, 0xff, 0xff, 0xff, 0xff
};

void setup() {
  // Start the serial connection
  Serial.begin(115200);

  // Wait for the serial monitor to open
  while (!Serial);

  Serial.println("Connecting to Adafruit IO...");

  // Connect to Adafruit IO via MQTT
  io.connect();



  // Set up a message handler for the 'zap1' feed
  zap1->onMessage(handleZap1Message);
  zap2->onMessage(handleZap2Message);

  // Initialize DHT sensor
  dht.begin();

  Serial.println("Connected to Adafruit IO!");

  // Initialize display
  if(!display.begin(SSD1306_SWITCHCAPVCC, 0x3C)) {
    Serial.println(F("SSD1306 allocation failed"));
    for(;;);
  }
  
  display.clearDisplay();
}
 int centerX = (SCREEN_WIDTH - 64) / 2; // Calculate X coordinate for centering

void loop() {
  // Keep the client connected to Adafruit IO and process incoming data
  io.run();

  // Read sensor data
  float temperature = dht.readTemperature(); // Read temperature
  float humidity = dht.readHumidity();       // Read humidity
  int soilMoistureValue = analogRead(soilMoisturePin); // Read soil moisture value

  // Print sensor readings to serial monitor
  Serial.print("Temperature: ");
  Serial.print(temperature);
  Serial.println(" °C");

  Serial.print("Humidity: ");
  Serial.print(humidity);
  Serial.println(" %");

  Serial.print("Soil Moisture: ");
  Serial.println(soilMoistureValue);

  // Check conditions for plant happiness
  if (temperature >= minTemperature && temperature <= maxTemperature &&
      humidity >= minHumidity && humidity <= maxHumidity &&
      soilMoistureValue >= minSoilMoisture) {
   
        display.clearDisplay();
        display.drawBitmap(centerX, 0,happy, 64, 64, SSD1306_WHITE); // Draw the calendar symbol
        display.display();
        delay(5000);
      display.clearDisplay();

  } else {
      
    if (temperature < minTemperature || temperature > maxTemperature) {


      display.clearDisplay();
      display.drawBitmap(centerX, 0,sad, 64, 64, SSD1306_WHITE); // Draw the calendar symbol
      display.display(); 
      delay(5000);
      display.clearDisplay();
   
       display.clearDisplay();
       display.drawBitmap(centerX, 0,sun, 64, 64, SSD1306_WHITE); // Draw the calendar symbol
        display.display();  
      delay(5000);
      display.clearDisplay();


    } else if (humidity < minHumidity || humidity > maxHumidity) {


      display.clearDisplay();
      display.drawBitmap(centerX, 0,sad, 64, 64, SSD1306_WHITE); // Draw the calendar symbol
      display.display();    
      delay(5000);
      display.clearDisplay();
    
        display.clearDisplay();
        display.drawBitmap(centerX, 0, thermometer, 64, 64, SSD1306_WHITE); // Draw the calendar symbol
        display.display();
      delay(5000);
      display.clearDisplay();


    } else if (soilMoisture < minSoilMoisture) {


      
      display.clearDisplay();
      display.drawBitmap(centerX, 0,sad, 64, 64, SSD1306_WHITE); // Draw the calendar symbol
      display.display();    
      delay(5000);
      delay(5000);
      display.clearDisplay();



     
    
        display.clearDisplay();
        display.drawBitmap(centerX, 0,water, 64, 64, SSD1306_WHITE); // Draw the calendar symbol
        display.display();
        delay(5000);
         display.clearDisplay();
        
    } 
  }

  delay(3000); // Delay before taking next readings
}

// Message handler for the 'zap1' feed
void handleZap1Message(AdafruitIO_Data *data) {
  // 'Calendar', 64x64px

  // Print the received value to the serial monitor
  Serial.print("Received value from 'zap1': ");
  Serial.println(data->value());

  // Check if the received value is "ON"
  if (strcmp(data->value(), "1") == 0) {

    Serial.println("Calendar Updated");
    display.clearDisplay();
    display.drawBitmap(centerX, 0,sad, 64, 64, SSD1306_WHITE); // Draw the calendar symbol
    display.display();    
    delay(5000);
    display.clearDisplay();
    
    
  } 
}


// Message handler for the 'zap2' feed
void handleZap2Message(AdafruitIO_Data *data) {
  // Print the received value to the serial monitor
  //mail

  Serial.print("Received value from 'zap2': ");
  Serial.println(data->value());

  // Check if the received value is "2"
  if (strcmp(data->value(), "2") == 0) {
      Serial.println("Received mail");
      display.clearDisplay();
      display.drawBitmap(centerX, 0,sad, 64, 64, SSD1306_WHITE); // Draw the calendar symbol
      display.display();    
      delay(5000);
      display.clearDisplay();

  
  } 
}




